## arch/arm/mach-s5l8900/Kconfig
```kconfig
config CPU_S5L8900
	bool
	select PLAT_S5L
	select CPU_V6
	select S5P_EXT_INT
	select S3C_PL330_DMA
	select MFD_PCF50633
	select PCF50633_ADC
	select PCF50633_GPIO
	select CHARGER_PCF50633
	select BACKLIGHT_PCF50633
	select REGULATOR_PCF50633
	select RTC_DRV_PCF50633
	select RTC_DRV_PCF50633_OFFSET
	select INPUT_PCF50633_PMU
	help
	  Enable S5L8900 CPU support
```

## arch/arm/mach-s5l8930/Kconfig
```kconfig
# Copyright (c) 2011 Richard Ian Taylor
#
#	This file is part of the iDroid Project 
#	(http://www.idroidproject.org/).

config CPU_S5L8930
	bool
	select PLAT_S5L
	select S5L_IRQ
	select CPU_V7
	help
	  Enable S5L8930 CPU support

config MACH_IPHONE_4
	bool "iPhone 4"
	select CPU_S5L8930
	help
	  Enable support for the iPhone 4.

config MACH_IPOD_TOUCH_4G
	bool "iPod Touch 4G"
	select CPU_S5L8930
	help
	  Enable support for the 4th generation
	  iPod Touch.
```

## arch/arm/plat-s5l/Kconfig
```kconfig
# Copyright (c) 2011 Richard Ian Taylor
#
#	This file is part of the iDroid Project 
#	(http://www.idroidproject.org/).

comment "Machine Types"

config PLAT_S5L
	bool
	select ARM_VIC
	select NO_IOPORT
	select ARCH_REQUIRE_GPIOLIB
	select GENERIC_CLOCKEVENTS
	help
	  Base platform code for Samsung's S5L series SoC.

config S5L_IRQ
	bool
	depends on PLAT_S5L
```

## arch/arm/plat-s5l8930/KConfig
```kconfig
menu "S5L8930 Device Type"
	depends on ARCH_S5L8930

choice
	prompt "Model"
	default IPHONE_4

config IPHONE_4
	bool "iPhone 4"
	help
	  Select this option if the device is a forth generation iPhone.

config IPAD_1G
	bool "iPad 1G"
	help
	  Select this option if the device is a first generation iPad.

config IPODTOUCH_4G
	bool "iPod Touch 4G"
	help
	  Select this option if the device is a forth generation iPod Touch.
	
config APPLETV_2G
	bool "Apple TV 2G"
	help
	  Select this option if the device is a second generation Apple TV 2

endchoice
endmenu
```

## drivers/android/Kconfig
```kconfig
menu "Android"

config ANDROID_BINDER_IPC
	tristate "Binder IPC Driver"
	default y

config ANDROID_POWER
	bool "Android power driver"
	depends on PM && RTC_CLASS
	default n

config ANDROID_POWER_STAT
	bool "Android power driver lock stats"
	depends on ANDROID_POWER
	default y

endmenu
```

## drivers/block/apple/Kconfig
```kconfig
if BLK_DEV_APPLE

config BLK_DEV_APPLE_VSVFL
	tristate "Apple VSVFL support"
	---help---
		Includes support for flash memory
		with VSVFL formatting.

config BLK_DEV_APPLE_LEGACY_VFL
	tristate "Apple Legacy VFL support"
	---help---
		Includes support for flash memory
		formatted with Apple's legacy
		VFL.

config BLK_DEV_APPLE_YAFTL
	tristate "Apple YAFTL support"
	depends on BLK_DEV_APPLE_VSVFL

config BLK_DEV_APPLE_LEGACY_FTL
	tristate "Apple Legacy FTL support"
	depends on BLK_DEV_APPLE_VSVFL || BLK_DEV_APPLE_LEGACY_VFL

config BLK_DEV_H2FMI
	tristate "Apple H2FMI driver"
	depends on PLAT_S5L

config BLK_DEV_S5L8900
	tristate "Apple S5L8900 NAND driver"
	depends on PLAT_S5L

endif
```

## sound/soc/iphone/Kconfig
```kconfig
config SND_APPLE_IPHONE
	tristate "WM8578"
	depends on SND_SOC
	---help---
	Hacky driver for iPhone 2G and iPod Touch 1G Audio
```
